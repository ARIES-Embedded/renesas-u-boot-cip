## board/aries/mrzg2ls/Kconfig
```kconfig
if TARGET_MRZG2LS

config SYS_SOC
	default "rmobile"

config SYS_BOARD
	default "mrzg2ls"

config SYS_VENDOR
	default "aries"

config SYS_CONFIG_NAME
	default "mrzg2ls"

endif
```

## board/aries/mrzv2ls/Kconfig
```kconfig
if TARGET_MRZV2LS

config SYS_SOC
	default "rmobile"

config SYS_BOARD
	default "mrzv2ls"

config SYS_VENDOR
	default "aries"

config SYS_CONFIG_NAME
	default "mrzv2ls"

endif
```

## board/aries/msrzg2ls/Kconfig
```kconfig
if TARGET_MSRZG2LS

config SYS_SOC
	default "rmobile"

config SYS_BOARD
	default "msrzg2ls"

config SYS_VENDOR
	default "aries"

config SYS_CONFIG_NAME
	default "msrzg2ls"

endif
```

## board/aries/msrzg2ul/Kconfig
```kconfig
if TARGET_MSRZG2UL

config SYS_SOC
	default "rmobile"

config SYS_BOARD
	default "msrzg2ul"

config SYS_VENDOR
	default "aries"

config SYS_CONFIG_NAME
	default "msrzg2ul"

endif
```

## board/aries/msrzg3s/Kconfig
```kconfig
if TARGET_MSRZG3S

config SYS_SOC
	default "rmobile"

config SYS_BOARD
	default "msrzg3s"

config SYS_VENDOR
	default "aries"

config SYS_CONFIG_NAME
	default "msrzg3s"

endif
```
