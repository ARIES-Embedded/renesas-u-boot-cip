// SPDX-License-Identifier: GPL-2.0
/*
 * Device Tree Source for the MSRZ2GUL-A0A OSM
 *
 * Copyright (C) 2025 ARIES Embedded
 */

/dts-v1/;
#include "r9a07g043u11.dtsi"
#include "r9a07g043u11-u-boot.dtsi"
#include "msrzg2ul.dtsi"

/ {
	model = "msrzg2ul-a0a";
	compatible = "renesas,r9a07g043u", "renesas,rzg2ul", "renesas,rzg2ul-a0a";

	memory@48000000 {
		device_type = "memory";
		/* first 128MB is reserved for secure area. */
		reg = <0 0x48000000 0 0x18000000>;
	};

};
