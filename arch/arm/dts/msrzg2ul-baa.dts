// SPDX-License-Identifier: GPL-2.0
/*
 * Device Tree Source for the MSRZ2GUL-BAA OSM
 *
 * Copyright (C) 2025 ARIES Embedded
 */

/dts-v1/;
#include "r9a07g043u11.dtsi"
#include "r9a07g043u11-u-boot.dtsi"
#include "msrzg2ul.dtsi"

/ {
	model = "msrzg2ul-baa";
	compatible = "renesas,r9a07g043u", "renesas,rzg2ul", "renesas,rzg2ul-baa";

	memory@48000000 {
		device_type = "memory";
		/* first 128MB is reserved for secure area. */
		reg = <0 0x48000000 0 0x38000000>;
	};

};

&sdhi0 {
	bus-width = <8>;
	status = "okay";
	/* This is used for interface that support both eMMC and SD in board */
	mutual-channel;
};
